// Behaviors to support US like symbols when host layoust is SE

// , <
comm-labk: se-comm-se-labk {
  compatible = "zmk,behavior-mod-morph";
  label = "SE_COMM_SE_LABK";
  #binding-cells = <0>;
  bindings = <&kp SE_COMM>, <&kp SE_LABK>;
  mods = <(MOD_LALT|MOD_RALT)>;
};